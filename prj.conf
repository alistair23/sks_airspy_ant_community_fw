## prj.conf
```kconfig
# Copyright (c) 2026 Arne Wendt (@bitmeal)
# SPDX-License-Identifier: MPL-2.0


## image signing
# injected by CMake
# CONFIG_MCUBOOT_SIGNATURE_KEY_FILE="mcuboot.pem"


## size optimizations
CONFIG_LTO=y
CONFIG_ISR_TABLES_LOCAL_DECLARATION=y


## hardware info
CONFIG_HW_ID_LIBRARY=y
CONFIG_HW_ID_LIBRARY_SOURCE_DEVICE_ID=y


## power & device management
CONFIG_PM_DEVICE=y
CONFIG_POWEROFF=y

## clocks
# clock LFCLK from the internal RC oscillator instead of the 32.768 kHz
# crystal (LFXO). Some units have a damaged crystal and result in a crash
# in MPSL/SoftDevice Controller timing assertions as soon as BLE performs
# anything timing-sensitive, which is pretty much always.
# Costs a small battery overhead for periodic RC recalibration against HFCLK.
CONFIG_CLOCK_CONTROL_NRF_K32SRC_RC=y
CONFIG_CLOCK_CONTROL_NRF_K32SRC_500PPM=y

CONFIG_RESET_ON_FATAL_ERROR=n


## logging
CONFIG_LOG=y
CONFIG_LOG_MODE_DEFERRED=y
CONFIG_LOG_BACKEND_RTT=y
CONFIG_LOG_BACKEND_BLE=y
CONFIG_LOG_PROCESS_THREAD_STACK_SIZE=2048
CONFIG_NCS_APPLICATION_BOOT_BANNER_STRING="AIRSPY Community"

## ZBUS
CONFIG_ZBUS=y

## SPI
CONFIG_SPI_BITBANG=y
CONFIG_SPI_NRFX=n
# CONFIG_SOC_NRF52832_ALLOW_SPIM_DESPITE_PAN_58=y

## BT
CONFIG_BT=y
CONFIG_BT_DEVICE_NAME="AIRSPY Community"
CONFIG_BT_DEVICE_NAME_DYNAMIC=y
CONFIG_BT_DEVICE_NAME_MAX=23
# https://www.bluetooth.com/wp-content/uploads/Files/Specification/HTML/Assigned_Numbers/out/en/Assigned_Numbers.pdf?v=1729112093517
# 0x0559 / 1369 Vehicle Tire Pressure Sensor
# CONFIG_BT_DEVICE_APPEARANCE=1369
# 0x0480 / 1152 Generic Cycling
CONFIG_BT_DEVICE_APPEARANCE=1152
CONFIG_BT_PERIPHERAL=y
CONFIG_BT_SMP=y
CONFIG_BT_MAX_CONN=1

# Disable Bluetooth ping support
CONFIG_BT_CTLR_LE_PING=n

# Allow for large Bluetooth data packets.
# --> DFU
CONFIG_BT_L2CAP_TX_MTU=498
CONFIG_BT_BUF_ACL_RX_SIZE=502
CONFIG_BT_BUF_ACL_TX_SIZE=502
CONFIG_BT_CTLR_DATA_LENGTH_MAX=251


## ANT
CONFIG_ANT=y
CONFIG_ANT_TOTAL_CHANNELS_ALLOCATED=1
# Evaluation key for ANT
# Set this Kconfig to use the evaluation stack for SINGLE CORE builds (for example, nRF52 Series).
# You MUST obtain a valid commercial license key BEFORE releasing a product to market that uses ANT.
# For more information about licensing please see CONFIG_ANT_LICENSE_KEY and visit the website below:
# https://www.thisisant.com/developer/ant/licensing
CONFIG_ANT_EVALUATION_KEY=y

CONFIG_ANT_CHANNEL_CONFIG=y
CONFIG_ANT_KEY_MANAGER=y

CONFIG_HEAP_MEM_POOL_SIZE=4096

# TPMS
CONFIG_ANT_COMMON=y


## Settings storage
CONFIG_NVS=y
CONFIG_SETTINGS=y
CONFIG_SETTINGS_NVS=y

# allow flash writes
CONFIG_MPU_ALLOW_FLASH_WRITE=y

## DFU
# Enable MCUmgr and dependencies.
CONFIG_MCUMGR=y

CONFIG_FLASH=y
CONFIG_STREAM_FLASH=y
CONFIG_FLASH_MAP=y
CONFIG_NET_BUF=y
CONFIG_ZCBOR=y
CONFIG_CRC=y

# add 256 bytes to accommodate upload command
CONFIG_MAIN_STACK_SIZE=2048
CONFIG_SYSTEM_WORKQUEUE_STACK_SIZE=2304

# Enable most core commands.
CONFIG_IMG_MANAGER=y
CONFIG_MCUMGR_GRP_IMG=y
CONFIG_MCUMGR_GRP_OS=y
CONFIG_MCUMGR_GRP_OS_MCUMGR_PARAMS=y

# disable storage erase to keep persistent settings
CONFIG_MCUMGR_GRP_ZBASIC_STORAGE_ERASE=n

# Enable the Bluetooth mcumgr transport (unauthenticated).
CONFIG_MCUMGR_TRANSPORT_BT=y
CONFIG_MCUMGR_TRANSPORT_BT_AUTHEN=n
CONFIG_MCUMGR_TRANSPORT_BT_CONN_PARAM_CONTROL=y

# Enable the mcumgr Packet Reassembly feature over Bluetooth and its configuration dependencies.
# MCUmgr buffer size is optimized to fit one SMP packet divided into five Bluetooth Write Commands,
# transmitted with the maximum possible MTU value: 498 bytes.
CONFIG_MCUMGR_TRANSPORT_BT_REASSEMBLY=y
CONFIG_MCUMGR_TRANSPORT_NETBUF_SIZE=2475
CONFIG_MCUMGR_TRANSPORT_WORKQUEUE_STACK_SIZE=4608

# allow mcumgr callbacks for image management hooks
CONFIG_MCUMGR_MGMT_NOTIFICATION_HOOKS=y
CONFIG_MCUMGR_GRP_IMG_STATUS_HOOKS=y
```

## debug.conf
```kconfig
# SPDX-License-Identifier: MPL-2.0
#
# Diagnostic configuration fragment for bench debugging over RTT/SWD.
# Catches faults early and cleanly instead of escalating to CPU lockup,
# and flushes every log message immediately so the last messages before a
# sudden reset are not lost in the deferred logging buffer.
# Immediate mode logging distorts timing; do not use for release builds.
#
# usage:
#   west build --board sks_airspy --no-sysbuild <app dir> -- -DEXTRA_CONF_FILE=debug.conf

## logging: immediate mode, larger RTT up-buffer
CONFIG_LOG_MODE_DEFERRED=n
CONFIG_LOG_MODE_IMMEDIATE=y
CONFIG_SEGGER_RTT_BUFFER_SIZE_UP=4096

## LFCLK from internal RC oscillator instead of the 32.768 kHz crystal
# diagnostic for units with a broken/marginal LFXO (SDC assertions, failing
# BLE connections): the RC oscillator needs no external crystal; MPSL/SDC
# periodically recalibrate it against HFCLK
CONFIG_CLOCK_CONTROL_NRF_K32SRC_RC=y
CONFIG_CLOCK_CONTROL_NRF_K32SRC_500PPM=y

## fault diagnostics
# enable runtime asserts (e.g. ANT profile TX error checks)
CONFIG_ASSERT=y
CONFIG_ASSERT_VERBOSE=y
# MPU-based stack overflow detection: fault at the moment of overflow,
# with an intact stack for the fault handler, instead of a later lockup
CONFIG_HW_STACK_PROTECTION=y
# check stack sentinel on context switch as a fallback
CONFIG_STACK_SENTINEL=y
# thread names in fault dumps
CONFIG_THREAD_NAME=y
# halt on fatal error (default CONFIG_RESET_ON_FATAL_ERROR=n already set in
# prj.conf); fault dump goes to RTT
```

## src/spi.c
```c
/*
 * Copyright (c) 2025 Arne Wendt (@bitmeal)
 * SPDX-License-Identifier: MPL-2.0
 */

#include <zephyr/kernel.h>
#include <zephyr/device.h>
#include <zephyr/devicetree.h>
#include <zephyr/drivers/gpio.h>
#include <zephyr/drivers/spi.h>

#include <zephyr/logging/log.h>
LOG_MODULE_REGISTER(spim, LOG_LEVEL_INF);

#include "spi.h"
#include "zbus_com.h"
#include "sensor.h"

// SPI:
//  /INT: active low
//  CLK: idle low
//  sample on CLK rise
//  freq: 47 / 4.5317e-3 ^= 10.37 kHz

#define SPI_MASTER_DT_LABEL spi_master
#define SPI_MASTER_NODE DT_NODELABEL(SPI_MASTER_DT_LABEL)

// SPI slave 
const struct device *spim_dev;
static const struct gpio_dt_spec int_gpio = GPIO_DT_SPEC_GET(SPI_MASTER_NODE, cs_gpios);

static const struct spi_config spim_cfg = {
	// .frequency = 125000,
	.frequency = 10000,
	.operation =	SPI_WORD_SET(8) |
					// SPI_TRANSFER_MSB |
					SPI_OP_MODE_MASTER,
	.slave = 0,
	.cs = NULL
};
#define SPIM_INT_TRANSFER_DELAY_MS 0


static void spim_receive(struct k_work *work);
K_WORK_DELAYABLE_DEFINE(spim_receive_work, spim_receive);

static struct gpio_callback int_cb_data;
void int_cb_handler(const struct device *dev, struct gpio_callback *cb,
						  uint32_t pins)
{
	LOG_DBG("interrupt signal received from slave; scheduling SPI receive");
	
	k_work_schedule(&spim_receive_work, K_MSEC(SPIM_INT_TRANSFER_DELAY_MS));
}

int spim_init(void)
{
	int ret;

	spim_dev = DEVICE_DT_GET(SPI_MASTER_NODE);

	if (spim_dev == NULL)
	{
		LOG_ERR("Could not get %s device", spim_dev->name);
		return EXIT_FAILURE;
	}

	if (!device_is_ready(spim_dev))
	{
		LOG_ERR("SPI slave device not ready!");
		return EXIT_FAILURE;
	}

	if (!gpio_is_ready_dt(&int_gpio))
	{
		LOG_ERR("Error: SPIM interrupt GPIO device %s is not ready",
				int_gpio.port->name);
		return EXIT_FAILURE;
	}

	ret = gpio_pin_configure_dt(&int_gpio, GPIO_INPUT);
	if (ret != 0)
	{
		LOG_ERR("Error %d: failed to configure %s pin %d",
			   ret, int_gpio.port->name, int_gpio.pin);
		return EXIT_FAILURE;
	}

	ret = gpio_pin_interrupt_configure_dt(&int_gpio, GPIO_INT_EDGE_TO_ACTIVE);
	if (ret != 0)
	{
		LOG_ERR("Error %d: failed to configure interrupt on %s pin %d\n",
			ret, int_gpio.port->name, int_gpio.pin);
		return EXIT_FAILURE;
	}

	gpio_init_callback(&int_cb_data, int_cb_handler, BIT(int_gpio.pin));

	ret = gpio_add_callback(int_gpio.port, &int_cb_data);
	if (ret != 0)
	{
		LOG_ERR("Error %d: failed to configure callback for interrupt on %s pin %d\n",
			ret, int_gpio.port->name, int_gpio.pin);
		return EXIT_FAILURE;
	}

	LOG_DBG("SPI device %s OK", spim_dev->name);

	return EXIT_SUCCESS;
}

static void spim_receive(struct k_work *work)
{
	int err;

	struct sensor_readings_t sensor_data;

	static uint8_t rx_buffer[SENSOR_BUFFER_SIZE];
	struct spi_buf rx_buf = {.buf = rx_buffer, .len = sizeof(rx_buffer),};
	const struct spi_buf_set rx = {.buffers = &rx_buf, .count = 1};

	err = spi_read(spim_dev, &spim_cfg, &rx);
	if (err < 0)
	{
		LOG_ERR("SPI error: %d", err);
	}
	else
	{
		err = decode_sensor_buffer(rx_buffer, &sensor_data);

		if (err == SENSOR_ERROR_CHK)
		{
			LOG_WRN("SPI sensor data checksum error! buff: %x; decoder: %x", rx_buffer[5], sensor_data.checksum);
			return;
		}
		
		LOG_HEXDUMP_DBG(rx_buffer, sizeof(rx_buffer), "SPI rx:");
		LOG_INF("P[hPa]: %u; T[C]: %d; V[mV]: %u", sensor_data.pressure_hpa, sensor_data.temperature_c, sensor_data.voltage_mv);

		zbus_chan_pub(&sensor_data_chan, &sensor_data, K_MSEC(250));
	}
}
```
